## main/Kconfig.projbuild
```kconfig
menu "Measurement Station Configuration"
    menu "WiFi Configuration"
        config ESP_WIFI_SSID
            string "WiFi SSID"
            default "*EDITME*"
            help
                SSID (network name) for the example to connect to.

        config ESP_WIFI_PASSWORD
            string "WiFi Password"
            default "*EDITME*"
            help
                WiFi password (WPA or WPA2) for the example to use.

        choice ESP_WIFI_SAE_MODE
            prompt "WPA3 SAE mode selection"
            default ESP_WPA3_SAE_PWE_BOTH
            help
                Select mode for SAE as Hunt and Peck, H2E or both.
            config ESP_WPA3_SAE_PWE_HUNT_AND_PECK
                bool "HUNT AND PECK"
            config ESP_WPA3_SAE_PWE_HASH_TO_ELEMENT
                bool "H2E"
            config ESP_WPA3_SAE_PWE_BOTH
                bool "BOTH"
        endchoice

        config ESP_WIFI_PW_ID
            string "PASSWORD IDENTIFIER"
            depends on  ESP_WPA3_SAE_PWE_HASH_TO_ELEMENT|| ESP_WPA3_SAE_PWE_BOTH
            default ""
            help
                password identifier for SAE H2E

        config ESP_MAXIMUM_RETRY
            int "Maximum retry"
            default 5
            help
                Set the Maximum retry to avoid station reconnecting to the AP unlimited when the AP is really inexistent.

        choice ESP_WIFI_SCAN_AUTH_MODE_THRESHOLD
            prompt "WiFi Scan auth mode threshold"
            default ESP_WIFI_AUTH_WPA2_PSK
            help
                The weakest authmode to accept in the scan mode.
                This value defaults to ESP_WIFI_AUTH_WPA2_PSK incase password is present and ESP_WIFI_AUTH_OPEN is used.
                Please select ESP_WIFI_AUTH_WEP/ESP_WIFI_AUTH_WPA_PSK incase AP is operating in WEP/WPA mode.

            config ESP_WIFI_AUTH_OPEN
                bool "OPEN"
            config ESP_WIFI_AUTH_WEP
                bool "WEP"
            config ESP_WIFI_AUTH_WPA_PSK
                bool "WPA PSK"
            config ESP_WIFI_AUTH_WPA2_PSK
                bool "WPA2 PSK"
            config ESP_WIFI_AUTH_WPA_WPA2_PSK
                bool "WPA/WPA2 PSK"
            config ESP_WIFI_AUTH_WPA3_PSK
                bool "WPA3 PSK"
            config ESP_WIFI_AUTH_WPA2_WPA3_PSK
                bool "WPA2/WPA3 PSK"
            config ESP_WIFI_AUTH_WAPI_PSK
                bool "WAPI PSK"
        endchoice

    endmenu

    menu "MQTT Configuration"
        config MQTT_URI
            string "MQTT server URI"
            default "*EDITME*"
            help
                URI to the MQTT server

        config INITIAL_MESSAGE_TOPIC
            string "Initial MQTT message topic"
            default "placeholder"
            help
                Initial message topic to be sent by MQTT client

        config INITIAL_MESSAGE_PAYLOAD
            string "Initial MQTT message payload"
            default "placeholder"
            help
                Initial message payload to be sent by MQTT client
    endmenu

    config MEASUREMENT_SEND_PERIOD
        int "Define the period between measurements"
        default 100
        help
            specify send period for measurements
    choice DEBUG_MODE
        prompt "Debug mode enabled?"
        default DEBUG_MODE_OFF
        help
            Enable debugging mode for measurement station
        config DEBUG_MODE_ON
            bool "on"
        config DEBUG_MODE_OFF
            bool "off"
    endchoice
endmenu
```
